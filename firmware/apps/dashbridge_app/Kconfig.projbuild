## firmware/apps/dashbridge_app/Kconfig.projbuild
```kconfig
menu "DashBridge"
choice BRIDGE_ROLE
    prompt "Board role"
    default BRIDGE_CAR
config BRIDGE_CAR
    bool "Board B: Tesla test receiver"
config BRIDGE_PHONE
    bool "Board A: iPhone notifications"
endchoice
config BRIDGE_CALL_RELAY
    bool "Two-board call relay"
    default y
config BRIDGE_MUSIC_RELAY
    bool "Codec-transparent two-board music relay"
    depends on BRIDGE_CALL_RELAY && BT_HFP_USE_EXTERNAL_CODEC
    select BT_A2DP_ENABLE
    select BT_A2DP_USE_EXTERNAL_CODEC
    default y
config BRIDGE_CONTACT_SYNC
    bool "Name/number PBAP relay for Tesla caller names"
    depends on BRIDGE_CALL_RELAY
    select BT_PBAC_ENABLED if BRIDGE_PHONE
    default y
endmenu
```

## firmware/main/Kconfig.projbuild
```kconfig
menu "DashBridge"
choice BRIDGE_ROLE
    prompt "Board role"
    default BRIDGE_CAR
config BRIDGE_CAR
    bool "Board B: Tesla test receiver"
config BRIDGE_PHONE
    bool "Board A: iPhone notifications"
config BRIDGE_SINGLE
    bool "Single board: iPhone and Tesla (experimental)"
endchoice
config BRIDGE_CALL_RELAY
    bool "Two-board call relay (hardware-unverified alpha)"
    depends on !BRIDGE_SINGLE
    default n
endmenu
```

## firmware/sdkconfig.defaults
```kconfig
CONFIG_IDF_TARGET="esp32"
CONFIG_ESPTOOLPY_FLASHSIZE_4MB=y
CONFIG_PARTITION_TABLE_SINGLE_APP_LARGE=y
CONFIG_BT_ENABLED=y
CONFIG_BT_BLUEDROID_ENABLED=y
CONFIG_BTDM_CTRL_MODE_BTDM=y
CONFIG_BT_CLASSIC_ENABLED=y
CONFIG_BT_SPP_ENABLED=y
CONFIG_BT_SDP_COMMON_ENABLED=y
CONFIG_BT_HFP_ENABLE=y
CONFIG_BT_HFP_AG_ENABLE=y
CONFIG_BT_HFP_AUDIO_DATA_PATH_HCI=y
CONFIG_BT_BLE_ENABLED=y
CONFIG_BT_GATTC_ENABLE=y
CONFIG_BT_GATTS_ENABLE=y
CONFIG_BT_BLE_SMP_ENABLE=y
CONFIG_BT_BLE_RPA_SUPPORTED=y
CONFIG_ESP_MAIN_TASK_STACK_SIZE=12288
CONFIG_BT_BTC_TASK_STACK_SIZE=8192
CONFIG_BT_BTU_TASK_STACK_SIZE=8192
CONFIG_COMPILER_CXX_EXCEPTIONS=n
CONFIG_COMPILER_CXX_RTTI=n
CONFIG_LOG_DEFAULT_LEVEL_INFO=y
```
